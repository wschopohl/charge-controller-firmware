## prj.conf
```kconfig
# Main application configuration (overrides board-specific settings)

# only very small heap necessary for malloc in printf statements with %f
CONFIG_HEAP_MEM_POOL_SIZE=256

CONFIG_CPLUSPLUS=y
CONFIG_LIB_CPLUSPLUS=y

CONFIG_NEWLIB_LIBC=y
CONFIG_NEWLIB_LIBC_NANO=y
CONFIG_NEWLIB_LIBC_FLOAT_PRINTF=y

CONFIG_WATCHDOG=y
CONFIG_WDT_DISABLE_AT_BOOT=y
CONFIG_TASK_WDT=y
CONFIG_THREAD_NAME=y

CONFIG_REBOOT=y

CONFIG_HWINFO=y

CONFIG_CONSOLE_SUBSYS=y
CONFIG_CONSOLE_GETCHAR=y

# Use minimal logging by default to save memory for STM32F0 with little RAM
CONFIG_LOG=y
CONFIG_LOG_MODE_MINIMAL=y

CONFIG_THINGSET=y
CONFIG_THINGSET_NESTED_JSON=y

# ThingSet protocol interface via UART serial
CONFIG_THINGSET_SERIAL=y

# Uncomment to disable regular data publication on ThingSet serial at startup
#CONFIG_THINGSET_SERIAL_PUB_DEFAULT=n

# Uncomment to use LS.one or debug RX/TX connector instead of UEXT serial for ThingSet
CONFIG_UEXT_SERIAL_THINGSET=n

# Uncomment to enable I2C OLED display in UEXT connector
#CONFIG_UEXT_OLED_DISPLAY=y

# Select initial battery configuration: GEL (default), FLOODED, AGM, LFP, NMC or NMC_HV
#CONFIG_BAT_TYPE_???=y

# Change number of cells considering selected type (12V/24V battery by default if not set)
#CONFIG_BAT_NUM_CELLS=?
```

## src/dcdc.cpp
```c
/*
 * Copyright (c) The Libre Solar Project Contributors
 *
 * SPDX-License-Identifier: Apache-2.0
 */

#include "dcdc.h"

#include <zephyr/kernel.h>

#include <zephyr/device.h>
#include <zephyr/drivers/gpio.h>

#include <math.h> // for fabs function
#include <stdio.h>
#include <stdlib.h> // for min/max function

#include "data_storage.h"
#include "device_status.h"
#include "half_bridge.h"
#include "helper.h"
#include "setup.h"

LOG_MODULE_REGISTER(dcdc, CONFIG_DCDC_LOG_LEVEL);

#if BOARD_HAS_DCDC

#define BUCK_DUTY_POWER_DECREASE (-1)
#define BUCK_DUTY_POWER_INCREASE (1)

#define BOOST_DUTY_POWER_DECREASE (1)
#define BOOST_DUTY_POWER_INCREASE (-1)

#ifdef CONFIG_SOC_SERIES_STM32G4X
#define DUTY_STEP_SIZE (3) // increased step size for fast microcontroller
#else
#define DUTY_STEP_SIZE (1) // single minimum step for other microcontrollers
#endif

#if DT_NODE_EXISTS(DT_CHILD(DT_PATH(outputs), hv_out))
#define HV_OUT_NODE DT_CHILD(DT_PATH(outputs), hv_out)
#endif

extern DeviceStatus dev_stat;

Dcdc::Dcdc(DcBus *high, DcBus *low, DcdcOperationMode op_mode)
{
    hvb = high;
    lvb = low;
    mode = op_mode;
    enable = true;
    state = DCDC_CONTROL_OFF;
    inductor_current_max = DT_PROP(DT_PATH(pcb), dcdc_current_max);
    hs_voltage_max = DT_PROP(DT_PATH(pcb), hs_voltage_max);
    ls_voltage_max = DT_PROP(DT_PATH(pcb), ls_voltage_max);
    ls_voltage_min = 9.0;
    output_power_min = 1; // switch off if power < 1 W
    restart_interval = 60;
    off_timestamp = -10000; // start immediately

    // lower duty limit might have to be adjusted dynamically depending on LS voltage
    half_bridge_init(DT_PROP(DT_INST(0, half_bridge), frequency) / 1000,
                     DT_PROP(DT_INST(0, half_bridge), deadtime), 12 / hs_voltage_max, 0.97);
}

void Dcdc::perturb_observe_buck()
{
    if (power >= output_power_min) {
        power_good_timestamp = uptime();
    }

    if ((uptime() - power_good_timestamp > 10 || power < -10.0) && mode != DCDC_MODE_AUTO) {
        // switch off after 10s low power or negative power (if not in nanogrid mode)
        pwm_direction = 0;
    }
    else if (lvb->voltage > lvb->sink_control_voltage()) {
        state = DCDC_CONTROL_CV_LS;
        pwm_direction = BUCK_DUTY_POWER_DECREASE;
    }
    else if (lvb->sink_current_margin < 0 || inductor_current > inductor_current_max) {
        state = DCDC_CONTROL_CC_LS;
        pwm_direction = BUCK_DUTY_POWER_DECREASE;
    }
    else if (hvb->src_current_margin > 0) {
        state = DCDC_CONTROL_CC_HS;
        pwm_direction = BUCK_DUTY_POWER_DECREASE;
    }
    else if (hvb->voltage < hvb->src_control_voltage() && power > output_power_min) {
        // input voltage below limit
        state = DCDC_CONTROL_CV_HS;
        pwm_direction = BUCK_DUTY_POWER_DECREASE;
    }
    else if (temp_mosfets > DCDC_MOSFETS_MAX_TEMP) {
        state = DCDC_CONTROL_DERATING;
        pwm_direction = BUCK_DUTY_POWER_DECREASE;
    }
    else if (power < output_power_min && lvb->voltage < lvb->src_control_voltage()) {
        // no load condition (e.g. start-up of nanogrid) --> raise voltage
        pwm_direction = BUCK_DUTY_POWER_INCREASE;
    }
    else {
        state = DCDC_CONTROL_MPPT;
        if (power_prev > power) {
            pwm_direction = -pwm_direction;
        }
    }

    power_prev = power;
}

void Dcdc::perturb_observe_boost()
{
    if (-power >= output_power_min) {
        power_good_timestamp = uptime();
    }

    if ((uptime() - power_good_timestamp > 10 || -power < -10.0) && mode != DCDC_MODE_AUTO) {
        // switch off after 10s low power or negative power (if not in nanogrid mode)
        pwm_direction = 0;
    }
    else if (hvb->voltage > hvb->sink_control_voltage()) {
        state = DCDC_CONTROL_CV_HS;
        pwm_direction = BOOST_DUTY_POWER_DECREASE;
    }
    else if (hvb->sink_current_margin < 0) {
        state = DCDC_CONTROL_CC_HS;
        pwm_direction = BOOST_DUTY_POWER_DECREASE;
    }
    else if (lvb->src_current_margin > 0 || -inductor_current > inductor_current_max) {
        state = DCDC_CONTROL_CC_LS;
        pwm_direction = BOOST_DUTY_POWER_DECREASE;
    }
    else if (lvb->voltage < lvb->src_control_voltage() && -power > output_power_min) {
        // input voltage below limit
        state = DCDC_CONTROL_CV_LS;
        pwm_direction = BOOST_DUTY_POWER_DECREASE;
    }
    else if (temp_mosfets > DCDC_MOSFETS_MAX_TEMP) {
        state = DCDC_CONTROL_DERATING;
        pwm_direction = BOOST_DUTY_POWER_DECREASE;
    }
    else if (-power < output_power_min && hvb->voltage < hvb->src_control_voltage()) {
        // no load condition (e.g. start-up of nanogrid) --> raise voltage
        pwm_direction = BOOST_DUTY_POWER_INCREASE;
    }
    else {
        state = DCDC_CONTROL_MPPT;
        if (-power_prev > -power) {
            pwm_direction = -pwm_direction;
        }
    }

    power_prev = power;
}

__weak DcdcOperationMode Dcdc::check_start_conditions()
{
    if (enable == false
        || hvb->voltage > hs_voltage_max // also critical for buck mode because of ringing
        || lvb->voltage > ls_voltage_max || lvb->voltage < ls_voltage_min
        || dev_stat.has_error(ERR_BAT_UNDERVOLTAGE | ERR_BAT_OVERVOLTAGE)
        || (int)uptime() < (off_timestamp + (int)restart_interval))
    {
        return DCDC_MODE_OFF;
    }

    if (lvb->sink_current_margin > 0 && lvb->voltage < lvb->sink_control_voltage()
        && hvb->src_current_margin < 0 && hvb->voltage > hvb->src_control_voltage()
        && hvb->voltage * 0.85 > lvb->voltage)
    {
        return DCDC_MODE_BUCK;
    }

    if (hvb->sink_current_margin > 0 && hvb->voltage < hvb->sink_control_voltage()
        && lvb->src_current_margin < 0 && lvb->voltage > lvb->src_control_voltage())
    {
        return DCDC_MODE_BOOST;
    }

    return DCDC_MODE_OFF;
}

bool Dcdc::check_hs_mosfet_short()
{
    static uint32_t first_time_detected;
    if (half_bridge_enabled() == false && inductor_current > 0.5F
        && lvb->voltage_filtered > lvb->sink_control_voltage())
    {
        // if there is current even though the DC/DC is switched off, the
        // high-side MOSFET must be broken --> set flag and let main() decide
        // what to do... (e.g. call dcdc_self_destruction)

        uint32_t now = uptime();
        if (first_time_detected == 0) {
            first_time_detected = now;
        }
        else if (now - first_time_detected > 10) {
            // waited approx 10s before setting the flag
            dev_stat.set_error(ERR_DCDC_HS_MOSFET_SHORT);
        }
    }
    else {
        first_time_detected = 0;
    }

    return dev_stat.has_error(ERR_DCDC_HS_MOSFET_SHORT);
}

bool Dcdc::startup_inhibit(bool reset)
{
    static uint32_t inhibit_start;

    if (reset) {
        inhibit_start = uptime();
        return true;
    }
    else {
        return (uptime() < inhibit_start + DCDC_STARTUP_INHIBIT_TIME);
    }
}

__weak void Dcdc::control()
{
    duty_cycle = half_bridge_get_duty_cycle() * 100.0;

    if (half_bridge_enabled() == false) {

        if (check_hs_mosfet_short()) {
            return;
        }

        int startup_mode = check_start_conditions();

        if ((startup_mode == DCDC_MODE_BUCK && mode == DCDC_MODE_BUCK)
            || (startup_mode == DCDC_MODE_BOOST && mode == DCDC_MODE_BOOST)
            || (startup_mode != DCDC_MODE_OFF && mode == DCDC_MODE_AUTO))
        {
            output_hvs_enable();

            // startup allowed, but we need to wait until voltages settle
            if (startup_inhibit()) {
                return;
            }

            const char *mode_name = NULL;
            if (startup_mode == DCDC_MODE_BUCK) {
                mode_name = "buck";
                pwm_direction = BUCK_DUTY_POWER_INCREASE;
                // Don't start directly at Vmpp (approx. 0.8 * Voc) to prevent high inrush
                // currents and stress on MOSFETs
                half_bridge_set_duty_cycle(lvb->voltage / (hvb->voltage - 1));
            }
            else {
                mode_name = "boost";
                pwm_direction = BOOST_DUTY_POWER_INCREASE;
                // Will automatically start with max. duty (0.97) if connected to a
                // nanogrid not yet started up (zero voltage)
                half_bridge_set_duty_cycle(lvb->voltage / (hvb->voltage + 1));
            }

            half_bridge_start();
            power_good_timestamp = uptime();
            printf("DC/DC %s mode start (HV: %.2fV, LV: %.2fV, PWM: %.1f).\n", mode_name,
                   hvb->voltage, lvb->voltage, half_bridge_get_duty_cycle() * 100);
        }
        else {
            startup_inhibit(true); // reset inhibit counter
        }
    }
    else { // half bridge is on

        const char *stop_reason = NULL;
        if (lvb->voltage > ls_voltage_max || hvb->voltage > hs_voltage_max) {
            stop_reason = "emergency (voltage limits exceeded)";
        }
        else if (enable == false) {
            stop_reason = "disabled";
        }
        else {
            if (sweep_active) {
                half_bridge_set_duty_cycle(sweep_value);
                sweep_value -= 0.001;
                if(sweep_value < 0.78) sweep_active = false;
                return;
            }
            if (mode == DCDC_MODE_BUCK || (mode == DCDC_MODE_AUTO && inductor_current > 0.1)) {
                perturb_observe_buck();
            }
            else {
                perturb_observe_boost();
            }

            if (pwm_direction != 0) {
                half_bridge_set_ccr(half_bridge_get_ccr() + pwm_direction * DUTY_STEP_SIZE);

                // requires floating point support with CONFIG_CBPRINTF_FP_SUPPORT=y
                LOG_DBG("P %.2fW, inductor %.2fA, HS: %.2fV, %.2fA margin, "
                        "LS: %.2fV (target %.2fV), %.2fA margin, "
                        "PWM: %.1f, dcdc_state: %d, pwm_direction: %d",
                        power, inductor_current, hvb->voltage, hvb->src_current_margin,
                        lvb->voltage, lvb->sink_voltage_intercept, lvb->sink_current_margin,
                        half_bridge_get_duty_cycle() * 100.0, state, pwm_direction);
            }
            else {
                stop_reason = "low power";
            }
        }

        if (stop_reason != NULL) {
            stop();
            printf("DC/DC Stop: %s.\n", stop_reason);
        }
    }
}

void Dcdc::test()
{
    if (half_bridge_enabled()) {
        const char *stop_reason = NULL;
        if (lvb->voltage > ls_voltage_max || hvb->voltage > hs_voltage_max) {
            stop_reason = "emergency (voltage limits exceeded)";
        }
        else if (enable == false) {
            stop_reason = "disabled";
        }
        else {
            if (half_bridge_get_duty_cycle() > 0.50) {
                half_bridge_set_ccr(half_bridge_get_ccr() - 1);
            }
            else {
                half_bridge_set_ccr(half_bridge_get_ccr() + 1);
            }
        }
        if (stop_reason != NULL) {
            stop();
            printf("DC/DC Stop: %s.\n", stop_reason);
        }
    }
    else {
        if (check_start_conditions() != DCDC_MODE_OFF) {
            // startup allowed, but we need to wait until voltages settle
            if (startup_inhibit()) {
                return;
            }

            half_bridge_set_duty_cycle(lvb->voltage / hvb->voltage);
            half_bridge_start();
            printf("DC/DC test mode start (HV: %.2fV, LV: %.2fV, PWM: %.1f).\n", hvb->voltage,
                   lvb->voltage, half_bridge_get_duty_cycle() * 100);
        }
        else {
            startup_inhibit(true); // reset inhibit counter
        }
    }
}

void Dcdc::pwm_sweep() 
{
    sweep_value = 0.95;
    sweep_active = true;
}

void Dcdc::stop()
{
    half_bridge_stop();
    state = DCDC_CONTROL_OFF;
    off_timestamp = uptime();
    output_hvs_disable();
}

void Dcdc::fuse_destruction()
{
    static int counter = 0;

    if (counter > 20) { // wait 20s to be able to send out data
        LOG_ERR("Charge controller fuse destruction called!\n");
        data_storage_write();
        half_bridge_stop();
        half_bridge_init(50, 0, 0, 0.98); // reset safety limits to allow 0% duty cycle
        half_bridge_set_duty_cycle(0);
        half_bridge_start();
        // now the fuse should be triggered and we disappear
    }
    counter++;
}

void Dcdc::output_hvs_enable()
{
#ifdef HV_OUT_NODE
    const struct device *hv_out = DEVICE_DT_GET(DT_GPIO_CTLR(HV_OUT_NODE, gpios));
    if (device_is_ready(hv_out)) {
        gpio_pin_configure(hv_out, DT_GPIO_PIN(HV_OUT_NODE, gpios),
                           DT_GPIO_FLAGS(HV_OUT_NODE, gpios) | GPIO_OUTPUT_ACTIVE);
    }
#endif
}

void Dcdc::output_hvs_disable()
{
#ifdef HV_OUT_NODE
    const struct device *hv_out = DEVICE_DT_GET(DT_GPIO_CTLR(HV_OUT_NODE, gpios));
    if (device_is_ready(hv_out)) {
        gpio_pin_configure(hv_out, DT_GPIO_PIN(HV_OUT_NODE, gpios),
                           DT_GPIO_FLAGS(HV_OUT_NODE, gpios) | GPIO_OUTPUT_INACTIVE);
    }
#endif
}

#else

Dcdc::Dcdc(DcBus *high, DcBus *low, DcdcOperationMode op_mode) {}

#endif /* BOARD_HAS_DCDC */
```

## src/dcdc.h
```c
/*
 * Copyright (c) The Libre Solar Project Contributors
 *
 * SPDX-License-Identifier: Apache-2.0
 */

#ifndef DCDC_H
#define DCDC_H

/**
 * @file
 *
 * @brief DC/DC buck/boost control functions
 *
 * High-level functions to control the DC/DC converter. This module does not directly access any
 * hardware. The PWM signal for the half bridge is generated in a separate module.
 */

#include <stdbool.h>
#include <stdint.h>

#ifdef __cplusplus

#include "power_port.h"

#define DCDC_STARTUP_INHIBIT_TIME 3 // seconds

#define DCDC_MOSFETS_MAX_TEMP (80) // °C

/**
 * DC/DC operation mode
 *
 * Defines which type of device is connected to the high side and low side ports
 */
enum DcdcOperationMode
{
    /**
     * DC/DC converter switched off
     */
    DCDC_MODE_OFF,

    /**
     * Buck converter mode
     *
     * Solar panel at high side port, battery / load at low side port (typical MPPT).
     */
    DCDC_MODE_BUCK,

    /**
     * Boost converter mode
     *
     * Battery at high side port, solar panel at low side (e.g. e-bike charging).
     */
    DCDC_MODE_BOOST,

    /**
     * Automatic mode selection
     *
     * Boost or buck mode is automatically chosen based on high-side and low-side port settings.
     *
     * May be used in nanogrid applications: Accept input power (if available and need for charging)
     * or provide output power (if no other power source available on the grid and battery charged)
     */
    DCDC_MODE_AUTO
};

/**
 * DC/DC control state
 *
 * Allows to determine the current control state (off, CC, CV and MPPT)
 */
enum DcdcControlState
{
    DCDC_CONTROL_OFF,     ///< DC/DC switched off (low input power or actively disabled)
    DCDC_CONTROL_MPPT,    ///< Maximum Power Point Tracking
    DCDC_CONTROL_CC_LS,   ///< Constant-Current control at low-side
    DCDC_CONTROL_CV_LS,   ///< Constant-Voltage control at low-side
    DCDC_CONTROL_CC_HS,   ///< Constant-Current control at high-side
    DCDC_CONTROL_CV_HS,   ///< Constant-Voltage control at high-side
    DCDC_CONTROL_DERATING ///< Hardware-limits (current or temperature) reached
};

/**
 * DC/DC class
 *
 * Contains all data belonging to the DC/DC sub-component of the PCB, incl.
 * actual measurements and calibration parameters.
 */
class Dcdc
{
public:
    /**
     * Initialize DC/DC and DC/DC port structs
     *
     * See http://libre.solar/docs/dcdc_control for detailed information
     *
     * @param high High voltage bus (e.g. solar input for MPPT buck)
     * @param low Low voltage bus (e.g. battery output for MPPT buck)
     * @param mode Operation mode (buck, boost or nanogrid)
     */
    Dcdc(DcBus *high, DcBus *low, DcdcOperationMode mode);

    /**
     * Check for valid start conditions of the DC/DC converter
     *
     * @returns operation mode that is valid for starting up
     */
    DcdcOperationMode check_start_conditions();

    /**
     * Main control function for the DC/DC converter
     *
     * If DC/DC is off, this function checks start conditions and starts conversion if possible.
     */
    void control();

    /**
     * Test mode for DC/DC, ramping up/down to 50% duty cycle
     */
    void test();

    void pwm_sweep();

    /**
     * Fast stop function (bypassing control loop)
     *
     * May be called from an ISR which detected overvoltage / overcurrent conditions.
     *
     * DC/DC will be restarted automatically from control function if condtions are valid.
     */
    void stop();

    /**
     * Prevent overcharging of battery in case of shorted HS MOSFET
     *
     * This function switches the LS MOSFET continuously on to blow the battery input fuse. The
     * reason for self destruction should be logged and stored to EEPROM prior to calling this
     * function, as the charge controller power supply will be cut after the fuse is destroyed.
     */
    void fuse_destruction();

    DcdcOperationMode mode; ///< DC/DC mode (buck, boost or nanogrid)
    bool enable;            ///< Can be used to disable the DC/DC power stage
    uint16_t state;         ///< Control state (off / MPPT / CC / CV)

    // actual measurements
    DcBus *hvb;             ///< Pointer to DC bus at high voltage side
    DcBus *lvb;             ///< Pointer to DC bus at low voltage (inductor) side
    float inductor_current; ///< Inductor current
    float power;            ///< Low-side power
    float temp_mosfets;     ///< MOSFET temperature measurement (if existing)

    // current state
    float power_prev;             ///< Stores previous conversion power (set via dcdc_control)
    int32_t pwm_direction;        ///< Direction of PWM change for MPPT
    int32_t off_timestamp;        ///< Last time the DC/DC was switched off
    int32_t power_good_timestamp; ///< Last time the DC/DC reached above minimum output power
    float duty_cycle = -1.0;

    // maximum allowed values
    float inductor_current_max = 0; ///< Maximum low-side (inductor) current
    float hs_voltage_max = 0;       ///< Maximum high-side voltage
    float ls_voltage_max;           ///< Maximum low-side voltage
    float ls_voltage_min;           ///< Minimum low-side voltage, e.g. for driver supply
    float output_power_min;         ///< Minimum output power (if lower, DC/DC is switched off)

    // calibration parameters
    uint32_t restart_interval; ///< Restart interval (s): When should we retry to start
                               ///< charging after low output power cut-off?

private:
    bool sweep_active = false;
    float sweep_value;
    /**
     * MPPT perturb & observe control (buck mode)
     *
     * @returns calculated pwm duty cycle delta or 0 if the DC/DC should be stopped
     */
    void perturb_observe_buck();

    /**
     * MPPT perturb & observe control (boost mode)
     *
     * @returns calculated pwm duty cycle delta or 0 if the DC/DC should be stopped
     */
    void perturb_observe_boost();

    /**
     * If manual control of the reverse polarity MOSFET on the high-side is available, this
     * function enables it to use the high voltage side as output.
     */
    void output_hvs_enable();

    /**
     * Disable the reverse polarity MOSFET on the high-side (if option available)
     */
    void output_hvs_disable();

    /**
     * Check if the high-side MOSFET is shorted
     */
    bool check_hs_mosfet_short();

    /**
     * Check if we need to wait for voltages to settle before starting the DC/DC
     *
     * @param reset Reset the inhibit counter if set to true
     *
     * @returns true if we need to wait
     */
    bool startup_inhibit(bool reset = false);
};

#endif // __cplusplus

#ifdef __cplusplus
extern "C" {
#endif

#ifdef CONFIG_CUSTOM_DCDC_CONTROLLER

/**
 * Low-level control function
 *
 * Implement this function e.g. for cycle-by-cylce current limitation.
 *
 * It is called from the DMA after each new current reading, i.e. it runs in ISR context with
 * high frequency and must be VERY fast!
 */
void dcdc_low_level_controller();

#endif // CONFIG_CUSTOM_DCDC_CONTROLLER

#ifdef __cplusplus
}
#endif

#endif /* DCDC_H */
```
